## conf/distro/fsl-qoriq.conf
```bitbake
require conf/distro/poky.conf

DISTRO = "fsl-qoriq"
DISTRO_NAME = "QorIQ SDK (FSL Reference Distro)"
DISTRO_VERSION = "2.0"
SDK_VENDOR = "-fslsdk"
SDK_VERSION = "2.0"
MAINTAINER = "Freescale Yocto Team <meta-freescale@yoctoproject.org>"

TARGET_VENDOR = "-fsl"

SDK_NAME_PREFIX = "${DISTRO}"
SDK_NAME = "${DISTRO}-${TCLIBC}-${SDK_ARCH}-${TUNE_PKGARCH}"

SANITY_TESTED_DISTROS += " \
    Fedora-22 \n \
    LinuxMint-15 \n \
"

POKY_DEFAULT_DISTRO_FEATURES_remove = " ptest"
DISTRO_FEATURES_DEFAULT_remove = " pcmcia 3g"
DISTRO_FEATURES_DEFAULT_append = " benchmark vfat ext2 mtd \
    alsa perl ppp python usbhost virtualization db"

# Set preferred toolchain version for arm targets
PREFERRED_VERSION_cross-localedef-native_qoriq-arm = "2.22%"
GCCVERSION_qoriq-arm = "linaro-4.9"
BINUVERSION_qoriq-arm = "linaro-2.25"
GLIBCVERSION_qoriq-arm = "linaro-2.20"
GDBVERSION_qoriq-arm = "linaro-7.8"

PREFERRED_VERSION_cross-localedef-native_qoriq-arm64 = "2.22%"
GCCVERSION_qoriq-arm64 = "linaro-4.9"
BINUVERSION_qoriq-arm64 = "linaro-2.25"
GLIBCVERSION_qoriq-arm64 = "linaro-2.20"
GDBVERSION_qoriq-arm64 = "linaro-7.8"

GCCVERSION_qoriq-ppc = "4.9.2"
BINUVERSION_qoriq-ppc = "2.25"
GLIBCVERSION_qoriq-ppc = "2.20"

# When meta-openenbedded layer included, bitbake will complain that
# multiple providers are available for jpeg (jpeg, libjpeg-turbo)
PREFERRED_PROVIDER_jpeg ?= "jpeg"
PREFERRED_PROVIDER_jpeg-native ?= "jpeg-native"

QEMU_TARGETS_append_pn-qemu-native = " ppc64"
PREFERRED_PROVIDER_virtual/java-initial-native = "cacao-initial-native"
PREFERRED_PROVIDER_virtual/java-native = "jamvm-native"
PREFERRED_PROVIDER_virtual/javac-native = "ecj-bootstrap-native"
PREFERRED_VERSION_openjdk-6-jre = "6b27-1.12.8"
PREFERRED_VERSION_icedtea6-native = "1.8.11"
PREFERRED_VERSION_openjdk-7-jre = "25b30-2.3.12"
PREFERRED_VERSION_icedtea7-native = "2.1.3"
PREFERRED_PROVIDER_openjdk-6-jre = "openjdk-6-jre"

# whiteliste restricted license
LICENSE_FLAGS_WHITELIST = "non-commercial_netperf commercial_lame"
```

## conf/machine/include/qoriq-arm64.inc
```bitbake
require conf/machine/include/qoriq-base.inc
require conf/machine/include/arm/arch-arm64.inc

KERNEL_IMAGETYPE = "Image"

MKUBIFS_ARGS ??= "-m 512 -e 15360 -c 12000"
UBINIZE_ARGS ??= "-m 512 -p 16KiB -s 512"

BBMASK = ".*openjre|.*openjdk"

PREFERRED_VERSION_docker = "1.9.0%"

MACHINEOVERRIDES .= ":qoriq-arm64"
```

## conf/machine/include/qoriq-base.inc
```bitbake
# Provides the QorIQ common settings
require conf/machine/include/soc-family.inc

# common providers of QorIQ targets
PREFERRED_PROVIDER_u-boot ?= "u-boot-qoriq"
PREFERRED_PROVIDER_virtual/bootloader ?= "u-boot-qoriq"
PREFERRED_PROVIDER_virtual/kernel ?= "linux-yocto"
PREFERRED_PROVIDER_cryptodev-linux ?= "cryptodev-qoriq-linux"
PREFERRED_PROVIDER_cryptodev-module ?= "cryptodev-qoriq-module"
PREFERRED_PROVIDER_cryptodev-tests ?= "cryptodev-qoriq-tests"
PREFERRED_PROVIDER_openssl = "openssl-qoriq"
PREFERRED_PROVIDER_qemu = "qemu-qoriq"

PREFERRED_VERSION_make = "3.81"
PREFERRED_VERSION_valgrind_e500v2 = "3.8.1+fsl"
PREFERRED_VERSION_samba = "3.6.24"

# Define the default image type
IMAGE_CLASSES ?= "image_types_uboot"
KERNEL_IMAGETYPE ?= "uImage"

MACHINE_FEATURES ?= "pci ext2 ext3 serial"
MACHINE_EXTRA_RRECOMMENDS ?= "udev-rules-qoriq"

EXTRA_IMAGEDEPENDS += "u-boot cst-native"

IPC_UST_SOC_bsc9131 = "B913x"
IPC_UST_SOC_bsc9132 = "B913x"
IPC_UST_SOC_b4 = "B4860"

MACHINEOVERRIDES =. "qoriq:"
```

## conf/machine/ls1043aqds-be.conf
```bitbake
#@TYPE: Machine
#@NAME: Freescale LS1043AQDS 
#@SOC: LSCH2
#@DESCRIPTION: Machine configuration for running LS1043A in 64-bit mode
#@MAINTAINER: Chunrong Guo <nxa13725@nxp.com>

DEFAULTTUNE = "aarch64_be"

require conf/machine/include/qoriq-arm64.inc

SOC_FAMILY = "fsl-lsch2"

UBOOT_CONFIG ??= "nand nor_ddr3 qspi sdcard_qspi sdcard_ifc lpuart nor"
UBOOT_CONFIG[nor] = "ls1043aqds_config,,u-boot-dtb.bin"
UBOOT_CONFIG[nand] = "ls1043aqds_nand_config,,u-boot-with-spl-pbl.bin"
UBOOT_CONFIG[nor_ddr3] = "ls1043aqds_nor_ddr3_config,,u-boot-dtb.bin"
UBOOT_CONFIG[qspi] = "ls1043aqds_qspi_config,,u-boot-dtb.bin"
UBOOT_CONFIG[sdcard_qspi] = "ls1043aqds_sdcard_qspi_config,,u-boot-with-spl-pbl.bin"
UBOOT_CONFIG[sdcard_ifc] = "ls1043aqds_sdcard_ifc_config,,u-boot-with-spl-pbl.bin"
UBOOT_CONFIG[lpuart] = "ls1043aqds_lpuart_config,,u-boot-dtb.bin"

LE_UBOOT_FOR_ARMBE_TARGET = "1"

KERNEL_DEVICETREE ?= "freescale/fsl-ls1043a-qds.dtb"
KERNEL_DEFCONFIG ?= "${S}/arch/arm64/configs/defconfig"
KBUILD_DEFCONFIG ?= "defconfig"
KERNEL_IMAGETYPE = "Image"

SERIAL_CONSOLES ?= "115200;ttyS0 115200;ttyAMA0"
SERIAL_CONSOLES_CHECK ?= "${SERIAL_CONSOLES}"

EXTRA_IMAGEDEPENDS += "fm-ucode rcw"

USE_VT = "0"
```

## conf/machine/ls1043ardb-be.conf
```bitbake
#@TYPE: Machine
#@NAME: Freescale LS1043ARDB 
#@SOC: LSCH2
#@DESCRIPTION: Machine configuration for running LS1043A in 64-bit mode
#@MAINTAINER: Chunrong Guo <nxa13725@nxp.com>

DEFAULTTUNE = "aarch64_be"

require conf/machine/include/qoriq-arm64.inc

SOC_FAMILY = "fsl-lsch2"

KERNEL_DEVICETREE ?= "freescale/fsl-ls1043a-rdb.dtb"
KERNEL_DEFCONFIG ?= "${S}/arch/arm64/configs/defconfig"
KBUILD_DEFCONFIG ?= "defconfig"
KERNEL_ITS_FILE ?= "ls1043ardb-be-kernel.its"
KERNEL_IMAGETYPE = "Image"

SERIAL_CONSOLES ?= "115200;ttyS0 115200;ttyAMA0"
SERIAL_CONSOLES_CHECK ?= "${SERIAL_CONSOLES}"

EXTRA_IMAGEDEPENDS += "fm-ucode rcw"
EXTRA_IMAGEDEPENDS_remove = "u-boot"

USE_VT = "0"
```

## conf/machine/ls1043ardb.conf
```bitbake
#@TYPE: Machine
#@NAME: Freescale LS1043ARDB 
#@SOC: LSCH2
#@DESCRIPTION: Machine configuration for running LS1043A in 64-bit mode
#@MAINTAINER: Chunrong Guo <nxa13725@nxp.com>

require conf/machine/include/qoriq-arm64.inc

SOC_FAMILY = "fsl-lsch2"

UBOOT_CONFIG ??= "nand sdcard nor"
UBOOT_CONFIG[nor] = "ls1043ardb_config,,u-boot-dtb.bin"
UBOOT_CONFIG[nand] = "ls1043ardb_nand_config,,u-boot-with-spl-pbl.bin"
UBOOT_CONFIG[sdcard] = "ls1043ardb_sdcard_config,,u-boot-with-spl-pbl.bin"
UBOOT_CONFIG[secure-boot] = "ls1043ardb_SECURE_BOOT_defconfig,,u-boot-dtb.bin"

QE_UCODE = "iram_Type_A_LS1021a_r1.0.bin"

KERNEL_DEVICETREE ?= "freescale/fsl-ls1043a-rdb.dtb freescale/fsl-ls1043a-rdb-usdpaa.dtb \
    freescale/fsl-ls1043a-uefi-rdb.dtb"
KERNEL_DEFCONFIG ?= "${S}/arch/arm64/configs/defconfig"
KBUILD_DEFCONFIG ?= "defconfig"

SERIAL_CONSOLES ?= "115200;ttyS0 115200;ttyAMA0"
SERIAL_CONSOLES_CHECK ?= "${SERIAL_CONSOLES}"

EXTRA_IMAGEDEPENDS += "fm-ucode rcw ppa qe-ucode"

USE_VT = "0"
```

## conf/machine/t2080rdb-64b.conf
```bitbake
#@TYPE: Machine
#@NAME: Freescale T2080RDB
#@SOC: t2080
#@DESCRIPTION: Machine configuration for Freescale QorIQ T2080 Reference
#              Design Board with ppce6500 core in 64b mode
#@MAINTAINER: Chunrong Guo <B40290@freescale.com>

require conf/machine/include/e6500-64b.inc

SOC_FAMILY = "t2:t2080"

UBOOT_CONFIG ??= "sdcard spi nand srio-pcie-boot secure-boot nor"
UBOOT_CONFIG[nor] = "T2080RDB_config"
UBOOT_CONFIG[sdcard] = "T2080RDB_SDCARD_config"
UBOOT_CONFIG[spi] = "T2080RDB_SPIFLASH_config"
UBOOT_CONFIG[nand] = "T2080RDB_NAND_config"
UBOOT_CONFIG[srio-pcie-boot] = "T2080RDB_SRIO_PCIE_BOOT_config"
UBOOT_CONFIG[secure-boot] = "T2080RDB_SECURE_BOOT_config"

UBOOT_SOURCE_NAND = "u-boot-with-spl-pbl.bin"
UBOOT_SOURCE_SPI = "u-boot-with-spl-pbl.bin"
UBOOT_SOURCE_SD = "u-boot-with-spl-pbl.bin"

HV_CFG_M = "t2080rdb"

KERNEL_DEVICETREE ?= "fsl/t2080rdb.dtb fsl/t2080rdb-usdpaa.dtb \
    fsl/t2080rdb-usdpaa-shared-interfaces.dtb \
"
KERNEL_DEFCONFIG ?= "${S}/arch/powerpc/configs/corenet64_fmanv3h_smp_defconfig"
KBUILD_DEFCONFIG ?= "corenet64_fmanv3h_smp_defconfig"

JFFS2_ERASEBLOCK = "0x10000"

EXTRA_IMAGEDEPENDS += "fm-ucode rcw hypervisor hv-cfg"

USE_VT ?= "0"
```
